/**
 * @cliArgs --device "AM64x_beta" --package "ALV" --part "Default" --context "r5fss0-0" --product "MCU_PLUS_SDK_AM64x@08.01.00"
 * @versions {"tool":"1.11.0+2225"}
 */

/**
 * Import the modules used in this configuration.
 */
const gpio       = scripting.addModule("/drivers/gpio/gpio", {}, false);
const gpio1      = gpio.addInstance();
const i2c        = scripting.addModule("/drivers/i2c/i2c", {}, false);
const i2c1       = i2c.addInstance();
const i2c2       = i2c.addInstance();
const debug_log  = scripting.addModule("/kernel/dpl/debug_log");
const mpu_armv7  = scripting.addModule("/kernel/dpl/mpu_armv7", {}, false);
const mpu_armv71 = mpu_armv7.addInstance();
const mpu_armv72 = mpu_armv7.addInstance();
const mpu_armv73 = mpu_armv7.addInstance();
const mpu_armv74 = mpu_armv7.addInstance();
const mpu_armv75 = mpu_armv7.addInstance();
const mpu_armv76 = mpu_armv7.addInstance();
const mpu_armv77 = mpu_armv7.addInstance();
const enet_icss  = scripting.addModule("/networking/enet_icss/enet_icss", {}, false);
const enet_icss1 = enet_icss.addInstance();

/**
 * Write custom configuration values to the imported modules.
 */
gpio1.$name                    = "CONFIG_GPIO0";
gpio1.pinDir                   = "OUTPUT";
gpio1.useMcuDomainPeripherals  = true;
gpio1.MCU_GPIO.$assign         = "MCU_GPIO0";
gpio1.MCU_GPIO.gpioPin.$assign = "ball.A7";

i2c1.$name           = "CONFIG_I2C0";
i2c1.I2C.$assign     = "I2C0";
i2c1.I2C.SCL.$assign = "ball.A18";
i2c1.I2C.SDA.$assign = "ball.B18";

i2c2.$name           = "CONFIG_I2C1";
i2c2.I2C.$assign     = "I2C1";
i2c2.I2C.SCL.$assign = "ball.C18";
i2c2.I2C.SDA.$assign = "ball.B19";

debug_log.enableUartLog = true;
debug_log.enableCssLog  = false;
debug_log.uartLog.$name = "CONFIG_UART0";

mpu_armv71.$name             = "CONFIG_MPU_REGION0";
mpu_armv71.size              = 31;
mpu_armv71.attributes        = "Device";
mpu_armv71.accessPermissions = "Supervisor RD+WR, User RD";
mpu_armv71.allowExecute      = false;

mpu_armv72.$name             = "CONFIG_MPU_REGION1";
mpu_armv72.size              = 15;
mpu_armv72.accessPermissions = "Supervisor RD+WR, User RD";

mpu_armv73.$name             = "CONFIG_MPU_REGION2";
mpu_armv73.baseAddr          = 0x41010000;
mpu_armv73.size              = 15;
mpu_armv73.accessPermissions = "Supervisor RD+WR, User RD";

mpu_armv74.$name             = "CONFIG_MPU_REGION3";
mpu_armv74.accessPermissions = "Supervisor RD+WR, User RD";
mpu_armv74.baseAddr          = 0x70000000;
mpu_armv74.size              = 23;

mpu_armv75.$name             = "CONFIG_MPU_REGION4";
mpu_armv75.accessPermissions = "Supervisor RD+WR, User RD";
mpu_armv75.baseAddr          = 0x80000000;
mpu_armv75.size              = 31;

mpu_armv76.$name             = "CONFIG_MPU_REGION5";
mpu_armv76.accessPermissions = "Supervisor RD+WR, User RD";
mpu_armv76.baseAddr          = 0xA5000000;
mpu_armv76.size              = 23;
mpu_armv76.attributes        = "NonCached";

mpu_armv77.$name    = "CONFIG_MPU_REGION6";
mpu_armv77.size     = 27;
mpu_armv77.baseAddr = 0x60000000;

enet_icss1.$name                              = "CONFIG_ENET_ICSS0";
enet_icss1.mode                               = "DUAL MAC";
enet_icss1.phyToMacInterfaceMode              = "RGMII";
enet_icss1.instance                           = "ICSSG0";
enet_icss1.phyAddr1                           = 1;
enet_icss1.phyAddr2                           = 2;
enet_icss1.PRU_ICSSG0_IEP.$assign             = "PRU_ICSSG0_IEP0";
enet_icss1.PRU_ICSSG0_IEP.EDC_LATCH_IN0.$used = false;
enet_icss1.PRU_ICSSG0_IEP.EDC_SYNC_OUT0.$used = false;
enet_icss1.PRU_ICSSG0_RGMII1.$assign          = "PRU_ICSSG0_RGMII1";
enet_icss1.PRU_ICSSG0_RGMII1.TD0.rx           = false;
enet_icss1.PRU_ICSSG0_RGMII1.TD1.rx           = false;
enet_icss1.PRU_ICSSG0_RGMII1.TD2.rx           = false;
enet_icss1.PRU_ICSSG0_RGMII1.TD3.rx           = false;
enet_icss1.PRU_ICSSG0_RGMII2.TD0.rx           = false;
enet_icss1.PRU_ICSSG0_RGMII2.TD1.rx           = false;
enet_icss1.PRU_ICSSG0_RGMII2.TD2.rx           = false;
enet_icss1.PRU_ICSSG0_RGMII2.TD3.rx           = false;

const pruicss   = scripting.addModule("/drivers/pruicss/pruicss", {}, false);
const pruicss1  = pruicss.addInstance({}, false);
pruicss1.$name  = "CONFIG_PRU_ICSS0";
enet_icss1.icss = pruicss1;

/**
 * These are the reserved peripherals and settings in this configuration
 */
const iSYSTEM1             = scripting.addPeripheral("SYSTEM");
iSYSTEM1.$name             = "MySYSTEM1";
iSYSTEM1.CLKOUT0.$assign   = "ball.A19";
iSYSTEM1.EXTINTn.$used     = false;
iSYSTEM1.EXT_REFCLK1.$used = false;
iSYSTEM1.FCLK_MUX.$used    = false;
iSYSTEM1.OBSCLK0.$used     = false;
iSYSTEM1.PORz_OUT.$used    = false;
iSYSTEM1.RESET_REQz.$used  = false;
iSYSTEM1.RESETSTATz.$used  = false;
iSYSTEM1.SYNC0_OUT.$used   = false;
iSYSTEM1.SYNC1_OUT.$used   = false;
iSYSTEM1.SYNC2_OUT.$used   = false;
iSYSTEM1.SYNC3_OUT.$used   = false;
iSYSTEM1.SYSCLKOUT0.$used  = false;

/**
 * Pinmux solution for unlocked pins/peripherals. This ensures that minor changes to the automatic solver in a future
 * version of the tool will not impact the pinmux you originally saw.  These lines can be completely deleted in order to
 * re-solve from scratch.
 */
debug_log.uartLog.UART.$suggestSolution              = "USART0";
debug_log.uartLog.UART.RXD.$suggestSolution          = "ball.D15";
debug_log.uartLog.UART.TXD.$suggestSolution          = "ball.C16";
enet_icss1.PRU_ICSSG0_MDIO.$suggestSolution          = "PRU_ICSSG0_MDIO0";
enet_icss1.PRU_ICSSG0_MDIO.MDC.$suggestSolution      = "ball.P3";
enet_icss1.PRU_ICSSG0_MDIO.MDIO.$suggestSolution     = "ball.P2";
enet_icss1.PRU_ICSSG0_RGMII1.RD0.$suggestSolution    = "ball.Y1";
enet_icss1.PRU_ICSSG0_RGMII1.RD1.$suggestSolution    = "ball.R4";
enet_icss1.PRU_ICSSG0_RGMII1.RD2.$suggestSolution    = "ball.U2";
enet_icss1.PRU_ICSSG0_RGMII1.RD3.$suggestSolution    = "ball.V2";
enet_icss1.PRU_ICSSG0_RGMII1.RXC.$suggestSolution    = "ball.T3";
enet_icss1.PRU_ICSSG0_RGMII1.RX_CTL.$suggestSolution = "ball.AA2";
enet_icss1.PRU_ICSSG0_RGMII1.TD0.$suggestSolution    = "ball.Y3";
enet_icss1.PRU_ICSSG0_RGMII1.TD1.$suggestSolution    = "ball.AA3";
enet_icss1.PRU_ICSSG0_RGMII1.TD2.$suggestSolution    = "ball.R6";
enet_icss1.PRU_ICSSG0_RGMII1.TD3.$suggestSolution    = "ball.V4";
enet_icss1.PRU_ICSSG0_RGMII1.TXC.$suggestSolution    = "ball.U4";
enet_icss1.PRU_ICSSG0_RGMII1.TX_CTL.$suggestSolution = "ball.T5";
enet_icss1.PRU_ICSSG0_RGMII2.$suggestSolution        = "PRU_ICSSG0_RGMII2";
enet_icss1.PRU_ICSSG0_RGMII2.RD0.$suggestSolution    = "ball.Y2";
enet_icss1.PRU_ICSSG0_RGMII2.RD1.$suggestSolution    = "ball.W2";
enet_icss1.PRU_ICSSG0_RGMII2.RD2.$suggestSolution    = "ball.V3";
enet_icss1.PRU_ICSSG0_RGMII2.RD3.$suggestSolution    = "ball.T4";
enet_icss1.PRU_ICSSG0_RGMII2.RXC.$suggestSolution    = "ball.R5";
enet_icss1.PRU_ICSSG0_RGMII2.RX_CTL.$suggestSolution = "ball.W3";
enet_icss1.PRU_ICSSG0_RGMII2.TD0.$suggestSolution    = "ball.W4";
enet_icss1.PRU_ICSSG0_RGMII2.TD1.$suggestSolution    = "ball.Y4";
enet_icss1.PRU_ICSSG0_RGMII2.TD2.$suggestSolution    = "ball.T6";
enet_icss1.PRU_ICSSG0_RGMII2.TD3.$suggestSolution    = "ball.U6";
enet_icss1.PRU_ICSSG0_RGMII2.TXC.$suggestSolution    = "ball.AA4";
enet_icss1.PRU_ICSSG0_RGMII2.TX_CTL.$suggestSolution = "ball.U5";
iSYSTEM1.$suggestSolution                            = "SYSTEM0";
